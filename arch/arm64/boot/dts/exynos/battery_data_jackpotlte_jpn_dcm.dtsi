/*
 * Jackpot Japan DCM Battery parameters device tree file
 *
 * Copyright (C) 2018 Samsung Electronics, Inc.
 *
 * This program is free software; you can redistribute it and/or
 * modify it under the terms of the GNU General Public License
 * as published by the Free Software Foundation; either version 2
 * of the License, or (at your option) any later version.
 *
 * This program is distributed in the hope that it will be useful,
 * but WITHOUT ANY WARRANTY; without even the implied warranty of
 * MERCHANTABILITY or FITNESS FOR A PARTICULAR PURPOSE.  See the
 * GNU General Public License for more details.
 *
 * You should have received a copy of the GNU General Public License
 * along with this program. If not, see <http://www.gnu.org/licenses/>.
 *
 */

/ {
	battery_params {
			battery,battery_data = 
				<
				/***** battery data for 4.2 *****/
				/* battery,battery_table3 */
				185 9 82 9 235 8 159 8 46 8
				208 7 168 7 98 7 254 6 196 6
				155 6 121 6 93 6 70 6 52 6
				21 6 245 5 196 5 141 5 129 5
				75 4 143 1 106 8 0 8 150 7
				43 7 193 6 87 6 237 5 130 5
				24 5 174 4 67 4 217 3 111 3
				4 3 154 2 48 2 198 1 91 1
				241 0 135 0 28 0 226 15

				/* battery,battery_table4 */
				10 10 10 10 58 62 61 60 61 62
				62 64 66 69 72 77 82 94 108 118
				140 194

				/* battery,batcap */
				0x88 0x27 0x69 0x07 /* [0x0E] [0x0F] [0x10] [0x11] */
				/* battery,accum */ 
				0x7 0xC2 /* [0x45] [0x44] */

				/* battery,soc_arr_val */
				10519 10000 9481 8962 8443 7924 7405 6886 6367 5848 5329 4810 4291 3772 3253 2734 2214 1695 1176 657 138 (-144)
				/* battery,ocv_arr_val */
				42152 41650 41148 40776 40224 39763 39568 39229 38740 38457 38255 38091 37956 37844 37754 37605 37445 37206 36939 36879 35366 31946

				/***** battery data for 4.18 *****/
				/* battery,battery_table3 */
				185 9 82 9 235 8 159 8 46 8
				208 7 168 7 98 7 254 6 196 6
				155 6 121 6 93 6 70 6 52 6
				21 6 245 5 196 5 141 5 129 5
				75 4 143 1 150 8 41 8 189 7
				80 7 228 6 120 6 11 6 159 5
				50 5 198 4 89 4 237 3 128 3
				20 3 168 2 59 2 207 1 98 1
				246 0 137 0 29 0 226 15

				/* battery,battery_table4 */
				10 10 10 10 58 62 61 60 61 62
				62 64 66 69 72 77 82 94 108 118
				140 194

				/* battery,batcap */
				0xC0 0x26 0x44 0x07 /* [0x0E] [0x0F] [0x10] [0x11] */
				/* battery,accum */
				0x7 0xC2 /* [0x45] [0x44] */

				/* battery,soc_arr_val */
				10731 10202 9672 9143 8613 8084 7554 7025 6495 5966 5436 4907 4377 3848 3318 2789 2259 1730 1200 671 141 (-147)
				/* battery,ocv_arr_val */
				42152 41650 41148 40776 40224 39763 39568 39229 38740 38457 38255 38091 37956 37844 37754 37605 37445 37206 36939 36879 35366 31946
		
				/***** battery data for 4.16 *****/
				/* battery,battery_table3 */
				185 9 82 9 235 8 159 8 46 8
				208 7 168 7 98 7 254 6 196 6
				155 6 121 6 93 6 70 6 52 6
				21 6 245 5 196 5 141 5 129 5
				75 4 143 1 200 8 89 8 234 7
				123 7 12 7 157 6 46 6 191 5
				80 5 226 4 115 4 4 4 149 3
				38 3 183 2 72 2 217 1 106 1
				251 0 140 0 30 0 225 15

				/* battery,battery_table4 */
				10 10 10 10 58 62 61 60 61 62
				62 64 66 69 72 77 82 94 108 118
				140 194

				/* battery,batcap */                                  
				 0xE4 0x25 0x1A 0x07 /* [0x0E] [0x0F] [0x10] [0x11] */ 
				/* battery,accum */
				0x7 0xC2 /* [0x45] [0x44] */

				/* battery,soc_arr_val */
				10975 10434 9892 9351 8809 8268 7726 7184 6643 6101 5560 5018 4477 3935 3394 2852 2311 1769 1227 686 144 (-150)
				/* battery,ocv_arr_val */
				42152 41650 41148 40776 40224 39763 39568 39229 38740 38457 38255 38091 37956 37844 37754 37605 37445 37206 36939 36879 35366 31946

				/***** battery data for 4.14 *****/
				/* battery,battery_table3 */
				185 9 82 9 235 8 159 8 46 8
				208 7 168 7 98 7 254 6 196 6
				155 6 121 6 93 6 70 6 52 6
				21 6 245 5 196 5 141 5 129 5
				75 4 143 1 6 9 148 8 34 8
				176 7 62 7 204 6 90 6 232 5
				118 5 4 5 146 4 32 4 174 3
				60 3 202 2 88 2 230 1 116 1
				2 1 144 0 30 0 224 15

				/* battery,battery_table4 */
				10 10 10 10 58 62 61 60 61 62
				62 64 66 69 72 77 82 94 108 118
				140 194

				/* battery,batcap */                                  
				0xE0 0x24 0xEA 0x06 /* [0x0E] [0x0F] [0x10] [0x11] */ 
				/* battery,accum */
				0x7 0xC2 /* [0x45] [0x44] */

				/* battery,soc_arr_val */
				11278 10722 10165 9609 9052 8496 7939 7383 6826 6270 5713 5157 4600 4044 3487 2931 2374 1818 1261 705 148 (-155)
				/* battery,ocv_arr_val */
				42152 41650 41148 40776 40224 39763 39568 39229 38740 38457 38255 38091 37956 37844 37754 37605 37445 37206 36939 36879 35366 31946

				/***** battery data for 4.09 *****/
				/* batterybattery_table3 */
				185 9 82 9 235 8 159 8 46 8
				208 7 168 7 98 7 254 6 196 6
				155 6 121 6 93 6 70 6 52 6
				21 6 245 5 196 5 141 5 129 5
				75 4 143 1 157 9 36 9 170 8
				49 8 183 7 62 7 197 6 75 6
				210 5 88 5 223 4 101 4 236 3
				114 3 249 2 128 2 6 2 141 1
				19 1 154 0 32 0 222 15

				/* batterybattery_table4 */
				10 10 10 10 58 62 61 60 61 62
				62 64 66 69 72 77 82 94 108 118
				140 194

				/* batterybatcap */                                  
				0x9C 0x22 0x7D 0x06 /* [0x0E] [0x0F] [0x10] [0x11] */ 
				/* batteryaccum */
				0x7 0xC2 /* [0x45] [0x44] */

				/* batterysoc_arr_val */
				12018 11425 10832 10239 9646 9053 8460 7867 7274 6681 6088 5495 4902 4309 3716 3123 2530 1937 1344 751 158 (-165)
				/* batteryocv_arr_val */
				42152 41650 41148 40776 40224 39763 39568 39229 38740 38457 38255 38091 37956 37844 37754 37605 37445 37206 36939 36879 35366 31946
				>;

			battery,battery_table3 = <185 9 82 9 235 8 159 8 46 8
				208 7 168 7 98 7 254 6 196 6
				155 6 121 6 93 6 70 6 52 6
				21 6 245 5 196 5 141 5 129 5
				75 4 143 1 106 8 0 8 150 7
				43 7 193 6 87 6 237 5 130 5
				24 5 174 4 67 4 217 3 111 3
				4 3 154 2 48 2 198 1 91 1
				241 0 135 0 28 0 226 15>;

			battery,battery_table4 = <10 10 10 10 58 62 61 60 61 62
				62 64 66 69 72 77 82 94 108 118
				140 194>;

			battery,batcap = <0x88 0x27 0x69 0x07>; /* [0x0E] [0x0F] [0x10] [0x11] */
			battery,accum = <0x7 0xC2>; /* [0x45] [0x44] */

			battery,soc_arr_val = <10519 10000 9481 8962 8443 7924 7405 6886 6367 5848 5329 4810 4291 3772 3253 2734 2214 1695 1176 657 138 (-144)>;
			battery,ocv_arr_val = <42152 41650 41148 40776 40224 39763 39568 39229 38740 38457 38255 38091 37956 37844 37754 37605 37445 37206 36939 36879 35366 31946>;
			
			battery,cycles_to_asoc_mapping = <
							0 80
							1101 50
							1801 49
							>;
	};

	battery {
		battery,fg_cycle_check_value = <1100>;
		battery,max_input_voltage = <5000>; /* mV */

		battery,full_condition_vcell = <4100>;
		battery,recharge_condition_vcell = <4130>;
		battery,chg_float_voltage = <4200>;
		battery,swelling_drop_float_voltage = <4050>;
		battery,swelling_high_rechg_voltage = <3900>;
		battery,swelling_low_rechg_voltage = <3900>;

		/* cycle, chg_float_voltage, recharge_condition_vcell, full_condition_vcell, full_condition_soc */
		battery,age_data = <0 4200 4130 4100 93	/*4.2*/
				200 4180 4110 4080 91	/*4.18*/
				250 4160 4090 4060 89	/*4.16*/
				300 4140 4070 4040 87	/*4.14*/
				1000 4090 4020 3990 83	/*4.09*/
				>;
	};
};
